#include <dt-bindings/zmk/matrix_transform.h>
#include "soflerightinvert.dtsi"
/ {
    chosen {
        zmk,kscan = &mock_kscan;
    };

    mock_kscan: mock_kscan_0 {
        compatible = "zmk,kscan-mock";
        columns = <0>;
        rows = <0>;
        events = <0>;
    };
};

#include "soflerightinvert.dtsi"

/ {
    chosen {
        zmk,kscan = &mock_kscan;
        zmk,physical-layout = &physical_layout_soflerightinvert;
    };
};
